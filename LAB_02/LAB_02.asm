ORG 0000H

MAIN:
MOV P1,#38H    // USE 2 LINES AND 5X7 MATRIX
ACALL COMMAND	//CALL COMMAND SUBROUTINE
ACALL DELAY	//GIVE LCD SOME TIME

MOV P1,#0EH     // LCD ON, CURSOR BLINKING 
ACALL COMMAND
ACALL DELAY

MOV P1,#01H	//CLEAR DISPLAY SCREEN
ACALL COMMAND
ACALL DELAY

MOV P1,#10H	//SHIFT CURSOR POSITION TO LEFT
ACALL COMMAND
ACALL DELAY

MOV P1,#06H	//INCREMENT CURSOR, SHIFT CURSOR TO RIGHT
ACALL COMMAND
ACALL DELAY

MOV P1,#80H	//CURSOR ON LINE 1 , POSITION 1
ACALL COMMAND
ACALL DELAY



MOV P1,#'H'	//DATA TO BE DISPLAYED 
ACALL DATAL
ACALL DELAY

MOV P1,#'A'    //DATA TO BE DISPLAYED
ACALL DATAL
ACALL DELAY

MOV P1,#'R'	//DATA TO BE DISPLAYED
ACALL DATAL
ACALL DELAY

MOV P1,#'S'     //DATA TO BE DISPLAYED
ACALL DATAL
ACALL DELAY

MOV P1,#'H'	//DATA TO BE DISPLAYED
ACALL DATAL
ACALL DELAY


HERE: SJMP HERE	//STAY HERE, DISPLAY AGAIN AND AGAIN

 
COMMAND:	//SEND COMMAND TO LCD
CLR P3.0	//CLEAR RS, PORT-3 PIN-10
CLR P3.1	//CLEAR RW, PORT-3 PIN-11
SETB P3.2	//SET E, PORT-3 PIN-12
ACALL DELAY
CLR P3.2	// CLEAR E, PORT-3 PIN-12
RET


DATAL:		//WRITE DATA TO LCD
SETB P3.0	//SET RS, PORT-3 PIN-10	
CLR P3.1	//CLEAR RW, PORT-3 PIN-11
SETB P3.2	//SET E, PORT-3 PIN-12
ACALL DELAY
CLR P3.2	// CLEAR E, PORT-3 PIN-12
RET

DELAY:
MOV R3, #50		//50 OT HIGHER FOR FAST CPUS
WAIT1: MOV R4, #255	//R4=255
WAIT: DJNZ R4, WAIT	//STAY UNTIL R4 BECOMES 0
DJNZ R3, WAIT1		//STAY UNTIL R3 BECOMES 0
RET
END
